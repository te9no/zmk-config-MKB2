&left_encoder {
    a-gpios = <&xiao_d 7 (GPIO_ACTIVE_HIGH | GPIO_PULL_UP)>;
    b-gpios = <&xiao_d 8 (GPIO_ACTIVE_HIGH | GPIO_PULL_UP)>;
    steps = <24>;
    status = "okay"; 
};

&sensors {
   triggers-per-rotation = <10>;
};