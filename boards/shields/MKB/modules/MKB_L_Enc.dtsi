#include <dt-bindings/zmk/bt.h>
#include <input/processors.dtsi>
#include <dt-bindings/zmk/input_transform.h>
#include <zephyr/dt-bindings/input/input-event-codes.h>

/ {
   left_encoder: encoder_left {
      compatible = "alps,ec11";
      a-gpios = <&xiao_d 7 (GPIO_ACTIVE_HIGH | GPIO_PULL_UP)>;
      b-gpios = <&xiao_d 8 (GPIO_ACTIVE_HIGH | GPIO_PULL_UP)>;
      steps = <12>;
      status = "disabled";
   };
};

&left_encoder {
    status = "okay";
};

/ {
    trackball_listener2 {
        compatible = "zmk,input-listener";
        status = "disabled";
        };
    };
};