#include "MKB_R_Base.dtsi"

&right_encoder{
    a-gpios = <&xiao_d 7 (GPIO_ACTIVE_LOW  | GPIO_PULL_UP)>;
    b-gpios = <&xiao_d 8 (GPIO_ACTIVE_LOW  | GPIO_PULL_UP)>;
    steps = <24>;
    status = "okay";
};
