#include <dt-bindings/zmk/bt.h>
#include <input/processors.dtsi>
#include <dt-bindings/zmk/input_transform.h>
#include <zephyr/dt-bindings/input/input-event-codes.h>
#include "MKB_pinctrl_R.dtsi"
#include "MKB.dtsi"

&default_transform {
    col-offset = <6>;
};
