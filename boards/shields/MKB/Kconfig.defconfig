## boards/shields/MKB/Kconfig.defconfig
```kconfig
config ZMK_SPLIT
    default y
    
if ZMK_DISPLAY
    config I2C
        default y

    config SSD1306
        default y
endif # ZMK_DISPLAY

if LVGL
    config LV_Z_VDB_SIZE
        default 64

    config LV_DPI_DEF
        default 148

    config LV_Z_BITS_PER_PIXEL
        default 1

    choice LV_COLOR_DEPTH
        default LV_COLOR_DEPTH_1
    endchoice
endif # LVGL

if SHIELD_MKB_L_Base
    config ZMK_KEYBOARD_NAME
        default "MeKaBu"

    config ZMK_SPLIT_ROLE_CENTRAL
        default y

    config ZMK_SPLIT_BLE_CENTRAL_PERIPHERALS
        default 1
endif

config ZMK_ZEROSHIFT_STUDIO
    default y if SHIELD_MKB_L_ZS && ZMK_STUDIO_RPC && !ZMK_SETTINGS_RESET_ON_START

config ZMK_BT_RECOVERY
    default y if ZMK_ZEROSHIFT && ZMK_SPLIT_BLE && !ZMK_SETTINGS_RESET_ON_START

config ZMK_BT_RECOVERY_DIAGNOSTICS
    default y if ZMK_BT_RECOVERY
```

## boards/shields/MKB/Kconfig.shield
```kconfig
config SHIELD_MKB_R_Base
    def_bool $(shields_list_contains,MKB_R_Base)

config SHIELD_MKB_L_Base
    def_bool $(shields_list_contains,MKB_L_Base)

config SHIELD_MKB_L_ZS
    def_bool $(shields_list_contains,MKB_L_ZS)

config SHIELD_MKB_R_ZS
    def_bool $(shields_list_contains,MKB_R_ZS)
```

## dts/bindings/input/mkb,deferred-analog-input.yaml
```yaml
description: MeKaBu analog stick initialized when selected
compatible: "mkb,deferred-analog-input"
include:
  - name: zmk,analog-input.yaml
  - name: base.yaml
    property-allowlist:
      - zephyr,deferred-init
```

## dts/bindings/input_processors/zmk,optical-dial-scroll.yaml
```yaml
description: Convert optical dial counts to vertical wheel steps
compatible: "zmk,optical-dial-scroll"
include: ip_zero_param.yaml
```

## dts/bindings/sensor/mkb,deferred-ec11.yaml
```yaml
# SPDX-License-Identifier: MIT

description: EC11 encoder on a MeKaBu slot initialized from the saved module selection
compatible: "mkb,deferred-ec11"

include:
  - name: alps,ec11.yaml
  - name: base.yaml
    property-allowlist:
      - zephyr,deferred-init
```
