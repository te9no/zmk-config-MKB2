## boards/shields/MKB/Kconfig.defconfig
```kconfig
config ZMK_SPLIT
    default y

if SHIELD_MKB_L_Base || SHIELD_MKB_L_ENC || SHIELD_MKB_L_JOY || SHIELD_MKB_L_TB || SHIELD_MKB_L_RZT || SHIELD_MKB_L_RZTv2 || SHIELD_MKB_L_RZTv2I2C || SHIELD_MKB_L_TPD || SHIELD_MKB_L_KEY
    config ZMK_KEYBOARD_NAME
        default "MeKaBu"

    config ZMK_SPLIT_ROLE_CENTRAL
        default y

    config ZMK_SPLIT_BLE_CENTRAL_PERIPHERALS
        default 1
endif
```

## boards/shields/MKB/Kconfig.shield
```kconfig
config SHIELD_MKB_R_Base
    def_bool $(shields_list_contains,MKB_R_Base)

config SHIELD_MKB_R_UNI
    def_bool $(shields_list_contains,MKB_R_UNI)


config SHIELD_MKB_L_Base
    def_bool $(shields_list_contains,MKB_L_Base)

config SHIELD_MKB_L_UNI
    def_bool $(shields_list_contains,MKB_L_UNI)

config ZMK_MKB_MODE_MUX
    bool "MKB shared-pin mode manager (SPI/I2C/QDEC)"
    default n
    select SETTINGS
    select PM_DEVICE
    help
      Manage exclusive ownership of P0.11/P0.12 across spi2, i2c0, and qdec0.
      Exposes behavior `&sm <mode>` and persists selected mode in settings.

config ZMK_MKB_MODE_MUX_INIT_PRIORITY
    int "MKB mode manager SYS_INIT priority (POST_KERNEL)"
    depends on ZMK_MKB_MODE_MUX
    default 0
```

## boards/shields/MKB/Module__L_TB/Kconfig.shield
```kconfig
config SHIELD_MKB_L_ENC
    def_bool $(shields_list_contains,SHIELD_MKB_L_Encoder)

config SHIELD_MKB_L_JOY
    def_bool $(shields_list_contains,SHIELD_MKB_L_JS_Enc)

config SHIELD_MKB_L_TB
    def_bool $(shields_list_contains,SHIELD_MKB_L_Trackball)
    
```

## boards/shields/MKB/dts/bindings/input_processors/zmk,input-processor-trixer.yaml
```yaml
# Copyright (c) 2026, The ZMK Contributors
# SPDX-License-Identifier: MIT

description: Input processor for 3 magnetometers Trackpuck

compatible: "zmk,input-processor-trixer"

include: ip_one_param.yaml

properties:

  sync-report-ms:
    type: int
    required: true
    default: 1

  radius-um:
    type: int
    required: false
    default: 18500
    description: Radius of magnet circle in micrometers (default 18.5mm)

  xy-sensitivity-num:
    type: int
    required: false
    default: 1
    description: XY sensitivity numerator for scaling raw to mm

  xy-sensitivity-denom:
    type: int
    required: false
    default: 1
    description: XY sensitivity denominator for scaling raw to mm

  z-sensitivity-num:
    type: int
    required: false
    default: 1
    description: Z sensitivity numerator for scaling raw to mm

  z-sensitivity-denom:
    type: int
    required: false
    default: 1
    description: Z sensitivity denominator for scaling raw to mm

  pitch-scale-num:
    type: int
    required: false
    default: 1
    description: Pitch output scale numerator

  pitch-scale-denom:
    type: int
    required: false
    default: 1
    description: Pitch output scale denominator

  roll-scale-num:
    type: int
    required: false
    default: 1
    description: Roll output scale numerator

  roll-scale-denom:
    type: int
    required: false
    default: 1
    description: Roll output scale denominator

  yaw-scale-num:
    type: int
    required: false
    default: 1
    description: Yaw output scale numerator

  yaw-scale-denom:
    type: int
    required: false
    default: 1
    description: Yaw output scale denominator

  yaw-comp-x-num:
    type: int
    required: false
    default: 0
    description: Yaw compensation for X translation numerator

  yaw-comp-x-denom:
    type: int
    required: false
    default: 1
    description: Yaw compensation for X translation denominator

  neutral-timeout-ms:
    type: int
    required: false
    default: 20
    description: Timeout in milliseconds before reporting neutral when all sensors are idle

  smooth-len:
    type: int
    default: 5
    description: Number of samples for smoothing

  rpt-dzn-x:
    type: int
    default: 9
    description: X-axis deadzone

  rpt-dzn-y:
    type: int
    default: 9
    description: Y-axis deadzone

  rpt-dzn-z:
    type: int
    default: 9
    description: Z-axis deadzone

  rpt-dzn-rx:
    type: int
    default: 9
    description: RX-axis deadzone

  rpt-dzn-ry:
    type: int
    default: 9
    description: RY-axis deadzone

  rpt-dzn-rz:
    type: int
    default: 9
    description: RZ-axis deadzone
```

## dts/bindings/behaviors/zmk,behavior-set-mode.yaml
```yaml
# SPDX-License-Identifier: MIT

description: Set shared-pin mode and reboot

compatible: "zmk,behavior-set-mode"

include: one_param.yaml
```

## dts/bindings/mkb,mode-mux-pinctrl.yaml
```yaml
# SPDX-License-Identifier: MIT

description: Pinctrl multiplexer helper node for MKB shared-pin mode switching

compatible: "mkb,mode-mux-pinctrl"

include: pinctrl-device.yaml
```
