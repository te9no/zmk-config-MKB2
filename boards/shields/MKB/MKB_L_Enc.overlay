#include "MKB_L_Base.dtsi"

/ {
   left_encoder: encoder_left {
      compatible = "alps,ec11";
      a-gpios = <&xiao_d 7 (GPIO_ACTIVE_HIGH | GPIO_PULL_UP)>;
      b-gpios = <&xiao_d 8 (GPIO_ACTIVE_HIGH | GPIO_PULL_UP)>;
      steps = <12>;
      status = "disabled";
   };
};

&left_encoder {
    status = "okay";
};
