/* SPDX-License-Identifier: MIT */

/ {
    behaviors {
        /omit-if-no-ref/ sm: set_mode {
            compatible = "zmk,behavior-set-mode";
            #binding-cells = <1>;
        };
    };
};
