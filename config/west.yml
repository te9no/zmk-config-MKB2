## config/west.yml
```yaml
manifest:
  remotes:
    - name: zmkfirmware
      url-base: https://github.com/zmkfirmware
    - name: caksoylar
      url-base: https://github.com/caksoylar
    - name: badjeff
      url-base: https://github.com/badjeff
    - name: te9no
      url-base: https://github.com/te9no
    - name: kot149
      url-base: https://github.com/kot149
    - name: mctechnology17
      url-base: https://github.com/mctechnology17
    - name: petejohanson
      url-base: https://github.com/petejohanson
    - name: cormoran
      url-base: https://github.com/cormoran
  projects:
    - name: zmk
      remote: cormoran
      revision: e5c9b6915b56801193e359dd9bad4a167ce0d1b8
      import: app/west.yml
    - name: zmk-rgbled-widget
      remote: caksoylar
      revision: e6b467792a1dabef8cfa5c9fd26bfefc9c16662b
    - name: zmk-analog-input-driver
      remote: badjeff
      revision: 2684f22ee7e2168d4393f7e63676912210a796fc
    - name: zmk-driver-pmw3610-with-custom-studio-rpc
      remote: cormoran
      revision: 5c34ea0eec246a1c986111417cd779b53144629a
    - name: zmk-driver-spi-three-wire
      remote: te9no
      revision: 4362133dbfbf66788b66b0a3e3c410b9232c06cb
      path: modules/zmk-driver-spi-three-wire
    - name: zmk-nice-oled
      remote: te9no
      revision: c511d7f64ba0f186051943d027333d247ad8e206
    - name: zmk-layout-shift
      remote: kot149
      revision: 4d71f7cb743256ac619873dd44f510e9e9562739
    - name: zmk-input-processor-keybind
      remote: te9no
      revision: 10ad463f2e3c7a7dfb4b7cffd6bddd0e9e8b5bae
    - name: zmk-driver-MLX90393
      remote: te9no
      revision: 42297df2ce839556eaee94e5ddcb8494355e1312
    - name: ads1220-zephyr-module
      remote: te9no
      revision: d618d1f3f198fd7e4ca3469da1683644be2d1b9f

    - name: zmk-module-runtime-input-processor
      remote: te9no
      revision: 72387b5212264d26d704dbc43c765f6485470a77
    - name: zmk-behavior-runtime-sensor-rotate
      remote: cormoran
      revision: 8b1125ed676c1f5e14145d217984f33d0ebdcef4
    - name: zmk-module-ble-management
      remote: cormoran
      revision: 57738cc4fc6ba80e82a7ac57741a0339cb186cd4
    - name: zmk-module-settings-rpc
      remote: cormoran
      revision: 083a299dd8d31c275809c5a249b12486be24a7d2
    - name: zmk-feature-runtime-combo
      remote: cormoran
      revision: d9490e7b5d41c516221d131241009e81740efcee
      import:
        name-blocklist:
          - zmk-feature-custom-settings
    - name: zmk-feature-runtime-macro
      remote: cormoran
      revision: 38530962eb7061b60efcb98e84585cfb1f0cb6de
      import:
        name-blocklist:
          - zmk-feature-custom-settings
    - name: zmk-feature-custom-settings
      remote: cormoran
      revision: c6a7fef3a3be3d3ace5de9a4b0628c6418cd1f3f
      path: zmk-feature-custom-settings
    - name: zmk-feature-device-info
      remote: cormoran
      revision: 8cedd2dd9f04e19ea5a17b94914dd47a09d8db11
    - name: zmk-feature-watchdog
      remote: cormoran
      revision: 84ad14c6c3645dc40b23f45d08ab45418655f912
    - name: zmk-feature-kscan-diagnostics
      remote: cormoran
      revision: 1432f7fe0cfe903cd7d3c9931ae6bd6f2e1f328e
    - name: zmk-module-devtool
      remote: cormoran
      revision: 9938a2c73c06d6e65ba2c0b68c9aa044a467eafc
    - name: zmk-feature-cdc-acm-bootloader-trigger
      remote: te9no
      revision: 1850754d269aab9ba73e4639371bfe59a4130e65
    - name: zmk-module-analoginput-rpc
      remote: te9no
      revision: e065461e907fa924c0029e1d4c94cec1d9093e17
    - name: zmk-module-battery-nrf-vddh-oversampling
      remote: te9no
      revision: 59fc126f859d4e7700186c9906e4645379763c34

  self:
    path: config

    
```
